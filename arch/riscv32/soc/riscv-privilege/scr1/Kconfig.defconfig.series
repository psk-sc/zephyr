## arch/riscv32/soc/riscv-privilege/scr1/Kconfig.defconfig.series
```kconfig
if SOC_SERIES_RISCV32_SCR1

config SOC_SERIES
	string
	default "scr1"

config SYS_CLOCK_HW_CYCLES_PER_SEC
	int
	default 25000000

config RISCV_SOC_INTERRUPT_INIT
	bool
	default y

config RISCV_HAS_CPU_IDLE
	bool
	default y

config NUM_IRQS
    int
    default 32

config XIP
	bool
	default y

config RISCV_RAM_BASE_ADDR
	hex
	default	0xffff0000

config RISCV_RAM_SIZE_KB
	int
	default 64

config RISCV_TCM_BASE_ADDR
	hex
	default	0xf0000000

config RISCV_TCM_SIZE_KB
	int
	default 64

config RISCV_RESET_VEC_ADDR
	hex
	default	0xffffff00

config RISCV_MACHINE_TRAP_ADDR
	hex
	default	0xffffff80

config RISCV_MTIME_BASE
	hex
	default	0xf0040000

config SCR_UART_BASE
	hex
	default	0xff010000

endif # SOC_SERIES_RISCV32_SCR1
```

## arch/riscv32/soc/riscv-privilege/scr1/Kconfig.series
```kconfig
# Kconfig - RISCV32_SCR1 SoC implementation
#
# Copyright (C) Syntacore 2017. All rights reserved.
#
# SPDX-License-Identifier: Apache-2.0
#

config SOC_SERIES_RISCV32_SCR1
	bool "Syntacore SCR1-based SoC implementation"
	depends on RISCV32
	select SOC_FAMILY_RISCV_PRIVILEGE
	help
	Enable support for Syntacore SCR1-based SoC
```

## arch/riscv32/soc/riscv-privilege/scr1/Kconfig.soc
```kconfig
# Kconfig - RISCV32_SCR1 SoC configuration options
#
# Copyright (C) Syntacore 2017. All rights reserved.
#
# SPDX-License-Identifier: Apache-2.0
#

choice
prompt "Syntacore SCR1-based SoC implementation"
depends on SOC_SERIES_RISCV32_SCR1

config SOC_RISCV32_SCR1
	bool "Syntacore SCR1-based SoC implementation"
	select ATOMIC_OPERATIONS_C

endchoice
```

## boards/riscv/vcu118_scr9/Kconfig.board
```kconfig
config BOARD_VCU118_SCR9
	bool "VCU118 FPGA SCR9 target"
	depends on SOC_RISCV64_SCR9
```

## boards/riscv32/de10_lite_scr1/Kconfig.board
```kconfig
config BOARD_DE10_LITE_SCR1
	bool "DE10-lite SCR1 target"
	depends on SOC_RISCV32_SCR1
```

## boards/riscv32/de10_lite_scr1/de10_lite_scr1_defconfig
```kconfig
CONFIG_RISCV32=y
CONFIG_SOC_SERIES_RISCV32_SCR1=y
CONFIG_SOC_RISCV32_SCR1=y
CONFIG_BOARD_DE10_LITE_SCR1=y
CONFIG_XIP=n
CONFIG_INCLUDE_RESET_VECTOR=y
CONFIG_CONSOLE=y
CONFIG_PRINTK=y
CONFIG_SERIAL=y
CONFIG_UART_SCR=y
CONFIG_UART_CONSOLE=y
CONFIG_UART_CONSOLE_ON_DEV_NAME="UART_0"
CONFIG_SCR1_MACHINE_TIMER=y
CONFIG_BOOT_BANNER=y
CONFIG_RISCV_RESET_VEC_ADDR=0xffffff00
CONFIG_MACHINE_TRAP_ADDR=0xffffff80
CONFIG_SCR_UART_BASE=0xff010000
CONFIG_RISCV_MTIME_BASE=0xf0040000
CONFIG_SYS_CLOCK_HW_CYCLES_PER_SEC=20000000
```

## drivers/serial/Kconfig.scr
```kconfig
# Kconfig.scr - scr UART configuration option
#
# Copyright (C) Syntacore 2015-2017. All rights reserved.
#
# SPDX-License-Identifier: Apache-2.0

menuconfig UART_SCR
	bool "riscv UART driver for SCR based SoCs"
	depends on SOC_SERIES_RISCV32_SCR1
	default n
	select SERIAL_HAS_DRIVER
	help
	Enable the UART driver for SCR based SoCs.
```

## soc/riscv/riscv-privilege/scr1/Kconfig.defconfig.series
```kconfig
if SOC_SERIES_RISCV32_SCR1

config SOC_SERIES
	string
	default "scr1"

config SYS_CLOCK_HW_CYCLES_PER_SEC
	int
	default 90000000

config RISCV_SOC_INTERRUPT_INIT
	bool
	default y

config RISCV_HAS_CPU_IDLE
	bool
	default y

config NUM_IRQS
	int
	default 32

config XIP
	bool
	default y

endif # SOC_SERIES_RISCV32_SCR1
```

## soc/riscv/riscv-privilege/scr7/Kconfig.series
```kconfig
# Kconfig - RISCV64_SCR7 SoC implementation
#
# Copyright (C) Syntacore 2022. All rights reserved.
#
# SPDX-License-Identifier: Apache-2.0
#

config SOC_SERIES_RISCV64_SCR7
	bool "Syntacore SCR7-based SoC implementation"
	select RISCV
	select RISCV_GP
	select 64BIT
	select SOC_FAMILY_RISCV_PRIVILEGE
	select RISCV_HAS_PLIC
	help
	Enable support for Syntacore SCR7-based SoC
```

## soc/riscv/riscv-privilege/scr9/Kconfig.series
```kconfig
# Kconfig - RISCV64_SCR9 SoC implementation
#
# Copyright (C) Syntacore 2022. All rights reserved.
#
# SPDX-License-Identifier: Apache-2.0
#

config SOC_SERIES_RISCV64_SCR9
	bool "Syntacore SCR9-based SoC implementation"
	select RISCV
	select RISCV_GP
	select 64BIT
	select SOC_FAMILY_RISCV_PRIVILEGE
	select RISCV_HAS_PLIC
	help
	Enable support for Syntacore SCR9-based SoC
```

## soc/riscv/riscv-privilege/scr9/Kconfig.soc
```kconfig
# Kconfig - RISCV64_SCR9 SoC configuration options
#
# Copyright (C) Syntacore 2022. All rights reserved.
#
# SPDX-License-Identifier: Apache-2.0
#

choice
prompt "Syntacore SCR9-based SoC implementation"
depends on SOC_SERIES_RISCV64_SCR9

config SOC_RISCV64_SCR9
	bool "Syntacore SCR9-based SoC implementation"
	select RISCV_ISA_RV64I
	select RISCV_ISA_EXT_M
	select RISCV_ISA_EXT_A
	select RISCV_ISA_EXT_C
	select RISCV_ISA_EXT_F
	select RISCV_ISA_EXT_D
	select RISCV_ISA_EXT_ZICSR
	select RISCV_ISA_EXT_ZIFENCEI

endchoice
```
