/*
 * Copyright (c) 2022 Syntacore
 *
 * SPDX-License-Identifier: Apache-2.0
 */

/dts-v1/;

#include "syntacore/scr1.dtsi"

/ {
	model = "vcu118_scr1";
	compatible = "scr,vcu118_scr1";

	chosen {
		zephyr,console = &uart0;
		/* Use TCM as SRAM by default */
		zephyr,sram = &tcm;
	};
};

